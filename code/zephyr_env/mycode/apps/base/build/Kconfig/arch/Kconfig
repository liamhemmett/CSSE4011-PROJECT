## code/zephyr_env/mycode/apps/base/build/Kconfig/arch/Kconfig
```kconfig
# Load arch Kconfig descriptions.
osource "/root/csse4011/project/CSSE4011-PROJECT/code/zephyr_env/zephyr/arch/x86/Kconfig"
osource "/root/csse4011/project/CSSE4011-PROJECT/code/zephyr_env/zephyr/arch/xtensa/Kconfig"
osource "/root/csse4011/project/CSSE4011-PROJECT/code/zephyr_env/zephyr/arch/sparc/Kconfig"
osource "/root/csse4011/project/CSSE4011-PROJECT/code/zephyr_env/zephyr/arch/riscv/Kconfig"
osource "/root/csse4011/project/CSSE4011-PROJECT/code/zephyr_env/zephyr/arch/posix/Kconfig"
osource "/root/csse4011/project/CSSE4011-PROJECT/code/zephyr_env/zephyr/arch/nios2/Kconfig"
osource "/root/csse4011/project/CSSE4011-PROJECT/code/zephyr_env/zephyr/arch/mips/Kconfig"
osource "/root/csse4011/project/CSSE4011-PROJECT/code/zephyr_env/zephyr/arch/arm64/Kconfig"
osource "/root/csse4011/project/CSSE4011-PROJECT/code/zephyr_env/zephyr/arch/arm/Kconfig"
osource "/root/csse4011/project/CSSE4011-PROJECT/code/zephyr_env/zephyr/arch/arc/Kconfig"
```

## code/zephyr_env/mycode/apps/base/build/Kconfig/soc/Kconfig
```kconfig
# Load Zephyr SoC Kconfig descriptions.
osource "/root/csse4011/project/CSSE4011-PROJECT/code/zephyr_env/zephyr/soc/xlnx/zynqmp/Kconfig"
osource "/root/csse4011/project/CSSE4011-PROJECT/code/zephyr_env/zephyr/soc/xlnx/zynq7000/Kconfig"
osource "/root/csse4011/project/CSSE4011-PROJECT/code/zephyr_env/zephyr/soc/xen/Kconfig"
osource "/root/csse4011/project/CSSE4011-PROJECT/code/zephyr_env/zephyr/soc/ti/simplelink/Kconfig"
osource "/root/csse4011/project/CSSE4011-PROJECT/code/zephyr_env/zephyr/soc/ti/lm3s6965/Kconfig"
osource "/root/csse4011/project/CSSE4011-PROJECT/code/zephyr_env/zephyr/soc/ti/k3/Kconfig"
osource "/root/csse4011/project/CSSE4011-PROJECT/code/zephyr_env/zephyr/soc/telink/tlsr/Kconfig"
osource "/root/csse4011/project/CSSE4011-PROJECT/code/zephyr_env/zephyr/soc/starfive/jh71xx/Kconfig"
osource "/root/csse4011/project/CSSE4011-PROJECT/code/zephyr_env/zephyr/soc/st/stm32/Kconfig"
osource "/root/csse4011/project/CSSE4011-PROJECT/code/zephyr_env/zephyr/soc/snps/qemu_arc/Kconfig"
osource "/root/csse4011/project/CSSE4011-PROJECT/code/zephyr_env/zephyr/soc/snps/nsim/Kconfig"
osource "/root/csse4011/project/CSSE4011-PROJECT/code/zephyr_env/zephyr/soc/snps/hsdk4xd/Kconfig"
osource "/root/csse4011/project/CSSE4011-PROJECT/code/zephyr_env/zephyr/soc/snps/hsdk/Kconfig"
osource "/root/csse4011/project/CSSE4011-PROJECT/code/zephyr_env/zephyr/soc/snps/emsk/Kconfig"
osource "/root/csse4011/project/CSSE4011-PROJECT/code/zephyr_env/zephyr/soc/snps/emsdp/Kconfig"
osource "/root/csse4011/project/CSSE4011-PROJECT/code/zephyr_env/zephyr/soc/snps/arc_iot/Kconfig"
osource "/root/csse4011/project/CSSE4011-PROJECT/code/zephyr_env/zephyr/soc/silabs/Kconfig"
osource "/root/csse4011/project/CSSE4011-PROJECT/code/zephyr_env/zephyr/soc/sifive/sifive_freedom/Kconfig"
osource "/root/csse4011/project/CSSE4011-PROJECT/code/zephyr_env/zephyr/soc/rockchip/Kconfig"
osource "/root/csse4011/project/CSSE4011-PROJECT/code/zephyr_env/zephyr/soc/renode/riscv_virtual/Kconfig"
osource "/root/csse4011/project/CSSE4011-PROJECT/code/zephyr_env/zephyr/soc/renesas/smartbond/Kconfig"
osource "/root/csse4011/project/CSSE4011-PROJECT/code/zephyr_env/zephyr/soc/renesas/rzt2m/Kconfig"
osource "/root/csse4011/project/CSSE4011-PROJECT/code/zephyr_env/zephyr/soc/renesas/rcar/Kconfig"
osource "/root/csse4011/project/CSSE4011-PROJECT/code/zephyr_env/zephyr/soc/renesas/ra/Kconfig"
osource "/root/csse4011/project/CSSE4011-PROJECT/code/zephyr_env/zephyr/soc/raspberrypi/Kconfig"
osource "/root/csse4011/project/CSSE4011-PROJECT/code/zephyr_env/zephyr/soc/quicklogic/eos_s3/Kconfig"
osource "/root/csse4011/project/CSSE4011-PROJECT/code/zephyr_env/zephyr/soc/qemu/virt_riscv/Kconfig"
osource "/root/csse4011/project/CSSE4011-PROJECT/code/zephyr_env/zephyr/soc/qemu/malta/Kconfig"
osource "/root/csse4011/project/CSSE4011-PROJECT/code/zephyr_env/zephyr/soc/openisa/rv32m1/Kconfig"
osource "/root/csse4011/project/CSSE4011-PROJECT/code/zephyr_env/zephyr/soc/nxp/s32/Kconfig"
osource "/root/csse4011/project/CSSE4011-PROJECT/code/zephyr_env/zephyr/soc/nxp/rw/Kconfig"
osource "/root/csse4011/project/CSSE4011-PROJECT/code/zephyr_env/zephyr/soc/nxp/mcx/Kconfig"
osource "/root/csse4011/project/CSSE4011-PROJECT/code/zephyr_env/zephyr/soc/nxp/lpc/Kconfig"
osource "/root/csse4011/project/CSSE4011-PROJECT/code/zephyr_env/zephyr/soc/nxp/layerscape/Kconfig"
osource "/root/csse4011/project/CSSE4011-PROJECT/code/zephyr_env/zephyr/soc/nxp/kinetis/Kconfig"
osource "/root/csse4011/project/CSSE4011-PROJECT/code/zephyr_env/zephyr/soc/nxp/imxrt/Kconfig"
osource "/root/csse4011/project/CSSE4011-PROJECT/code/zephyr_env/zephyr/soc/nxp/imx/Kconfig"
osource "/root/csse4011/project/CSSE4011-PROJECT/code/zephyr_env/zephyr/soc/nuvoton/numicro/Kconfig"
osource "/root/csse4011/project/CSSE4011-PROJECT/code/zephyr_env/zephyr/soc/nuvoton/numaker/Kconfig"
osource "/root/csse4011/project/CSSE4011-PROJECT/code/zephyr_env/zephyr/soc/nuvoton/npcx/Kconfig"
osource "/root/csse4011/project/CSSE4011-PROJECT/code/zephyr_env/zephyr/soc/nordic/Kconfig"
osource "/root/csse4011/project/CSSE4011-PROJECT/code/zephyr_env/zephyr/soc/neorv32/Kconfig"
osource "/root/csse4011/project/CSSE4011-PROJECT/code/zephyr_env/zephyr/soc/native/inf_clock/Kconfig"
osource "/root/csse4011/project/CSSE4011-PROJECT/code/zephyr_env/zephyr/soc/microchip/miv/Kconfig"
osource "/root/csse4011/project/CSSE4011-PROJECT/code/zephyr_env/zephyr/soc/microchip/mec/Kconfig"
osource "/root/csse4011/project/CSSE4011-PROJECT/code/zephyr_env/zephyr/soc/lowrisc/opentitan/Kconfig"
osource "/root/csse4011/project/CSSE4011-PROJECT/code/zephyr_env/zephyr/soc/litex/litex_vexriscv/Kconfig"
osource "/root/csse4011/project/CSSE4011-PROJECT/code/zephyr_env/zephyr/soc/ite/ec/Kconfig"
osource "/root/csse4011/project/CSSE4011-PROJECT/code/zephyr_env/zephyr/soc/intel/raptor_lake/Kconfig"
osource "/root/csse4011/project/CSSE4011-PROJECT/code/zephyr_env/zephyr/soc/intel/lakemont/Kconfig"
osource "/root/csse4011/project/CSSE4011-PROJECT/code/zephyr_env/zephyr/soc/intel/intel_socfpga_std/Kconfig"
osource "/root/csse4011/project/CSSE4011-PROJECT/code/zephyr_env/zephyr/soc/intel/intel_socfpga/Kconfig"
osource "/root/csse4011/project/CSSE4011-PROJECT/code/zephyr_env/zephyr/soc/intel/intel_niosv/Kconfig"
osource "/root/csse4011/project/CSSE4011-PROJECT/code/zephyr_env/zephyr/soc/intel/intel_ish/Kconfig"
osource "/root/csse4011/project/CSSE4011-PROJECT/code/zephyr_env/zephyr/soc/intel/intel_adsp/Kconfig"
osource "/root/csse4011/project/CSSE4011-PROJECT/code/zephyr_env/zephyr/soc/intel/elkhart_lake/Kconfig"
osource "/root/csse4011/project/CSSE4011-PROJECT/code/zephyr_env/zephyr/soc/intel/atom/Kconfig"
osource "/root/csse4011/project/CSSE4011-PROJECT/code/zephyr_env/zephyr/soc/intel/apollo_lake/Kconfig"
osource "/root/csse4011/project/CSSE4011-PROJECT/code/zephyr_env/zephyr/soc/intel/alder_lake/Kconfig"
osource "/root/csse4011/project/CSSE4011-PROJECT/code/zephyr_env/zephyr/soc/infineon/xmc/Kconfig"
osource "/root/csse4011/project/CSSE4011-PROJECT/code/zephyr_env/zephyr/soc/gd/gd32/Kconfig"
osource "/root/csse4011/project/CSSE4011-PROJECT/code/zephyr_env/zephyr/soc/gaisler/leon3/Kconfig"
osource "/root/csse4011/project/CSSE4011-PROJECT/code/zephyr_env/zephyr/soc/gaisler/gr716a/Kconfig"
osource "/root/csse4011/project/CSSE4011-PROJECT/code/zephyr_env/zephyr/soc/espressif/Kconfig"
osource "/root/csse4011/project/CSSE4011-PROJECT/code/zephyr_env/zephyr/soc/ene/kb1200/Kconfig"
osource "/root/csse4011/project/CSSE4011-PROJECT/code/zephyr_env/zephyr/soc/efinix/sapphire/Kconfig"
osource "/root/csse4011/project/CSSE4011-PROJECT/code/zephyr_env/zephyr/soc/cypress/Kconfig"
osource "/root/csse4011/project/CSSE4011-PROJECT/code/zephyr_env/zephyr/soc/cdns/xtensa_sample_controller/Kconfig"
osource "/root/csse4011/project/CSSE4011-PROJECT/code/zephyr_env/zephyr/soc/cdns/dc233c/Kconfig"
osource "/root/csse4011/project/CSSE4011-PROJECT/code/zephyr_env/zephyr/soc/brcm/bcmvk/Kconfig"
osource "/root/csse4011/project/CSSE4011-PROJECT/code/zephyr_env/zephyr/soc/brcm/bcm2712/Kconfig"
osource "/root/csse4011/project/CSSE4011-PROJECT/code/zephyr_env/zephyr/soc/brcm/bcm2711/Kconfig"
osource "/root/csse4011/project/CSSE4011-PROJECT/code/zephyr_env/zephyr/soc/atmel/sam0/Kconfig"
osource "/root/csse4011/project/CSSE4011-PROJECT/code/zephyr_env/zephyr/soc/atmel/sam/Kconfig"
osource "/root/csse4011/project/CSSE4011-PROJECT/code/zephyr_env/zephyr/soc/aspeed/Kconfig"
osource "/root/csse4011/project/CSSE4011-PROJECT/code/zephyr_env/zephyr/soc/arm/Kconfig"
osource "/root/csse4011/project/CSSE4011-PROJECT/code/zephyr_env/zephyr/soc/arm/beetle/Kconfig"
osource "/root/csse4011/project/CSSE4011-PROJECT/code/zephyr_env/zephyr/soc/andestech/Kconfig"
osource "/root/csse4011/project/CSSE4011-PROJECT/code/zephyr_env/zephyr/soc/ambiq/Kconfig"
osource "/root/csse4011/project/CSSE4011-PROJECT/code/zephyr_env/zephyr/soc/altr/zephyr_nios2f/Kconfig"
osource "/root/csse4011/project/CSSE4011-PROJECT/code/zephyr_env/zephyr/soc/altr/qemu_nios2/Kconfig"
```

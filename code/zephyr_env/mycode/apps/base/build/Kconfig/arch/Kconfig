## code/zephyr_env/mycode/apps/base/build/Kconfig/soc/Kconfig.soc
```kconfig
# Load SoC Kconfig descriptions.
osource "/root/csse4011/project/CSSE4011-PROJECT/code/zephyr_env/zephyr/soc/xlnx/zynqmp/Kconfig.soc"
osource "/root/csse4011/project/CSSE4011-PROJECT/code/zephyr_env/zephyr/soc/xlnx/zynq7000/Kconfig.soc"
osource "/root/csse4011/project/CSSE4011-PROJECT/code/zephyr_env/zephyr/soc/xen/Kconfig.soc"
osource "/root/csse4011/project/CSSE4011-PROJECT/code/zephyr_env/zephyr/soc/ti/simplelink/Kconfig.soc"
osource "/root/csse4011/project/CSSE4011-PROJECT/code/zephyr_env/zephyr/soc/ti/lm3s6965/Kconfig.soc"
osource "/root/csse4011/project/CSSE4011-PROJECT/code/zephyr_env/zephyr/soc/ti/k3/Kconfig.soc"
osource "/root/csse4011/project/CSSE4011-PROJECT/code/zephyr_env/zephyr/soc/telink/tlsr/Kconfig.soc"
osource "/root/csse4011/project/CSSE4011-PROJECT/code/zephyr_env/zephyr/soc/starfive/jh71xx/Kconfig.soc"
osource "/root/csse4011/project/CSSE4011-PROJECT/code/zephyr_env/zephyr/soc/st/stm32/Kconfig.soc"
osource "/root/csse4011/project/CSSE4011-PROJECT/code/zephyr_env/zephyr/soc/snps/qemu_arc/Kconfig.soc"
osource "/root/csse4011/project/CSSE4011-PROJECT/code/zephyr_env/zephyr/soc/snps/nsim/Kconfig.soc"
osource "/root/csse4011/project/CSSE4011-PROJECT/code/zephyr_env/zephyr/soc/snps/hsdk4xd/Kconfig.soc"
osource "/root/csse4011/project/CSSE4011-PROJECT/code/zephyr_env/zephyr/soc/snps/hsdk/Kconfig.soc"
osource "/root/csse4011/project/CSSE4011-PROJECT/code/zephyr_env/zephyr/soc/snps/emsk/Kconfig.soc"
osource "/root/csse4011/project/CSSE4011-PROJECT/code/zephyr_env/zephyr/soc/snps/emsdp/Kconfig.soc"
osource "/root/csse4011/project/CSSE4011-PROJECT/code/zephyr_env/zephyr/soc/snps/arc_iot/Kconfig.soc"
osource "/root/csse4011/project/CSSE4011-PROJECT/code/zephyr_env/zephyr/soc/silabs/Kconfig.soc"
osource "/root/csse4011/project/CSSE4011-PROJECT/code/zephyr_env/zephyr/soc/sifive/sifive_freedom/Kconfig.soc"
osource "/root/csse4011/project/CSSE4011-PROJECT/code/zephyr_env/zephyr/soc/rockchip/Kconfig.soc"
osource "/root/csse4011/project/CSSE4011-PROJECT/code/zephyr_env/zephyr/soc/renode/riscv_virtual/Kconfig.soc"
osource "/root/csse4011/project/CSSE4011-PROJECT/code/zephyr_env/zephyr/soc/renesas/smartbond/Kconfig.soc"
osource "/root/csse4011/project/CSSE4011-PROJECT/code/zephyr_env/zephyr/soc/renesas/rzt2m/Kconfig.soc"
osource "/root/csse4011/project/CSSE4011-PROJECT/code/zephyr_env/zephyr/soc/renesas/rcar/Kconfig.soc"
osource "/root/csse4011/project/CSSE4011-PROJECT/code/zephyr_env/zephyr/soc/renesas/ra/Kconfig.soc"
osource "/root/csse4011/project/CSSE4011-PROJECT/code/zephyr_env/zephyr/soc/raspberrypi/Kconfig.soc"
osource "/root/csse4011/project/CSSE4011-PROJECT/code/zephyr_env/zephyr/soc/quicklogic/eos_s3/Kconfig.soc"
osource "/root/csse4011/project/CSSE4011-PROJECT/code/zephyr_env/zephyr/soc/qemu/virt_riscv/Kconfig.soc"
osource "/root/csse4011/project/CSSE4011-PROJECT/code/zephyr_env/zephyr/soc/qemu/malta/Kconfig.soc"
osource "/root/csse4011/project/CSSE4011-PROJECT/code/zephyr_env/zephyr/soc/openisa/rv32m1/Kconfig.soc"
osource "/root/csse4011/project/CSSE4011-PROJECT/code/zephyr_env/zephyr/soc/nxp/s32/Kconfig.soc"
osource "/root/csse4011/project/CSSE4011-PROJECT/code/zephyr_env/zephyr/soc/nxp/rw/Kconfig.soc"
osource "/root/csse4011/project/CSSE4011-PROJECT/code/zephyr_env/zephyr/soc/nxp/mcx/Kconfig.soc"
osource "/root/csse4011/project/CSSE4011-PROJECT/code/zephyr_env/zephyr/soc/nxp/lpc/Kconfig.soc"
osource "/root/csse4011/project/CSSE4011-PROJECT/code/zephyr_env/zephyr/soc/nxp/layerscape/Kconfig.soc"
osource "/root/csse4011/project/CSSE4011-PROJECT/code/zephyr_env/zephyr/soc/nxp/kinetis/Kconfig.soc"
osource "/root/csse4011/project/CSSE4011-PROJECT/code/zephyr_env/zephyr/soc/nxp/imxrt/Kconfig.soc"
osource "/root/csse4011/project/CSSE4011-PROJECT/code/zephyr_env/zephyr/soc/nxp/imx/Kconfig.soc"
osource "/root/csse4011/project/CSSE4011-PROJECT/code/zephyr_env/zephyr/soc/nuvoton/numicro/Kconfig.soc"
osource "/root/csse4011/project/CSSE4011-PROJECT/code/zephyr_env/zephyr/soc/nuvoton/numaker/Kconfig.soc"
osource "/root/csse4011/project/CSSE4011-PROJECT/code/zephyr_env/zephyr/soc/nuvoton/npcx/Kconfig.soc"
osource "/root/csse4011/project/CSSE4011-PROJECT/code/zephyr_env/zephyr/soc/nordic/Kconfig.soc"
osource "/root/csse4011/project/CSSE4011-PROJECT/code/zephyr_env/zephyr/soc/neorv32/Kconfig.soc"
osource "/root/csse4011/project/CSSE4011-PROJECT/code/zephyr_env/zephyr/soc/native/inf_clock/Kconfig.soc"
osource "/root/csse4011/project/CSSE4011-PROJECT/code/zephyr_env/zephyr/soc/microchip/miv/Kconfig.soc"
osource "/root/csse4011/project/CSSE4011-PROJECT/code/zephyr_env/zephyr/soc/microchip/mec/Kconfig.soc"
osource "/root/csse4011/project/CSSE4011-PROJECT/code/zephyr_env/zephyr/soc/lowrisc/opentitan/Kconfig.soc"
osource "/root/csse4011/project/CSSE4011-PROJECT/code/zephyr_env/zephyr/soc/litex/litex_vexriscv/Kconfig.soc"
osource "/root/csse4011/project/CSSE4011-PROJECT/code/zephyr_env/zephyr/soc/ite/ec/Kconfig.soc"
osource "/root/csse4011/project/CSSE4011-PROJECT/code/zephyr_env/zephyr/soc/intel/raptor_lake/Kconfig.soc"
osource "/root/csse4011/project/CSSE4011-PROJECT/code/zephyr_env/zephyr/soc/intel/lakemont/Kconfig.soc"
osource "/root/csse4011/project/CSSE4011-PROJECT/code/zephyr_env/zephyr/soc/intel/intel_socfpga_std/Kconfig.soc"
osource "/root/csse4011/project/CSSE4011-PROJECT/code/zephyr_env/zephyr/soc/intel/intel_socfpga/Kconfig.soc"
osource "/root/csse4011/project/CSSE4011-PROJECT/code/zephyr_env/zephyr/soc/intel/intel_niosv/Kconfig.soc"
osource "/root/csse4011/project/CSSE4011-PROJECT/code/zephyr_env/zephyr/soc/intel/intel_ish/Kconfig.soc"
osource "/root/csse4011/project/CSSE4011-PROJECT/code/zephyr_env/zephyr/soc/intel/intel_adsp/Kconfig.soc"
osource "/root/csse4011/project/CSSE4011-PROJECT/code/zephyr_env/zephyr/soc/intel/elkhart_lake/Kconfig.soc"
osource "/root/csse4011/project/CSSE4011-PROJECT/code/zephyr_env/zephyr/soc/intel/atom/Kconfig.soc"
osource "/root/csse4011/project/CSSE4011-PROJECT/code/zephyr_env/zephyr/soc/intel/apollo_lake/Kconfig.soc"
osource "/root/csse4011/project/CSSE4011-PROJECT/code/zephyr_env/zephyr/soc/intel/alder_lake/Kconfig.soc"
osource "/root/csse4011/project/CSSE4011-PROJECT/code/zephyr_env/zephyr/soc/infineon/xmc/Kconfig.soc"
osource "/root/csse4011/project/CSSE4011-PROJECT/code/zephyr_env/zephyr/soc/gd/gd32/Kconfig.soc"
osource "/root/csse4011/project/CSSE4011-PROJECT/code/zephyr_env/zephyr/soc/gaisler/leon3/Kconfig.soc"
osource "/root/csse4011/project/CSSE4011-PROJECT/code/zephyr_env/zephyr/soc/gaisler/gr716a/Kconfig.soc"
osource "/root/csse4011/project/CSSE4011-PROJECT/code/zephyr_env/zephyr/soc/espressif/Kconfig.soc"
osource "/root/csse4011/project/CSSE4011-PROJECT/code/zephyr_env/zephyr/soc/ene/kb1200/Kconfig.soc"
osource "/root/csse4011/project/CSSE4011-PROJECT/code/zephyr_env/zephyr/soc/efinix/sapphire/Kconfig.soc"
osource "/root/csse4011/project/CSSE4011-PROJECT/code/zephyr_env/zephyr/soc/cypress/Kconfig.soc"
osource "/root/csse4011/project/CSSE4011-PROJECT/code/zephyr_env/zephyr/soc/cdns/xtensa_sample_controller/Kconfig.soc"
osource "/root/csse4011/project/CSSE4011-PROJECT/code/zephyr_env/zephyr/soc/cdns/dc233c/Kconfig.soc"
osource "/root/csse4011/project/CSSE4011-PROJECT/code/zephyr_env/zephyr/soc/brcm/bcmvk/Kconfig.soc"
osource "/root/csse4011/project/CSSE4011-PROJECT/code/zephyr_env/zephyr/soc/brcm/bcm2712/Kconfig.soc"
osource "/root/csse4011/project/CSSE4011-PROJECT/code/zephyr_env/zephyr/soc/brcm/bcm2711/Kconfig.soc"
osource "/root/csse4011/project/CSSE4011-PROJECT/code/zephyr_env/zephyr/soc/atmel/sam0/Kconfig.soc"
osource "/root/csse4011/project/CSSE4011-PROJECT/code/zephyr_env/zephyr/soc/atmel/sam/Kconfig.soc"
osource "/root/csse4011/project/CSSE4011-PROJECT/code/zephyr_env/zephyr/soc/aspeed/Kconfig.soc"
osource "/root/csse4011/project/CSSE4011-PROJECT/code/zephyr_env/zephyr/soc/arm/Kconfig.soc"
osource "/root/csse4011/project/CSSE4011-PROJECT/code/zephyr_env/zephyr/soc/arm/beetle/Kconfig.soc"
osource "/root/csse4011/project/CSSE4011-PROJECT/code/zephyr_env/zephyr/soc/andestech/Kconfig.soc"
osource "/root/csse4011/project/CSSE4011-PROJECT/code/zephyr_env/zephyr/soc/ambiq/Kconfig.soc"
osource "/root/csse4011/project/CSSE4011-PROJECT/code/zephyr_env/zephyr/soc/altr/zephyr_nios2f/Kconfig.soc"
osource "/root/csse4011/project/CSSE4011-PROJECT/code/zephyr_env/zephyr/soc/altr/qemu_nios2/Kconfig.soc"
```
